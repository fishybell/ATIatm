## open_embedded_stable_ati/oe_at91sam/conf/machine/at91sam9g20ek.conf
```bitbake
#@TYPE: Machine
#@Name: Atmel AT91SAM9G20EK Development Platform
#@DESCRIPTION: Machine configuration for the at91sam9260ek development board with a at91sam9g20 processor

TARGET_ARCH = "arm"

PREFERRED_PROVIDER_virtual/kernel = "linux"

KERNEL_IMAGETYPE = "uImage"

#don't try to access tty1
USE_VT = "0"

MACHINE_FEATURES = "kernel26 alsa ext2 usbhost usbgadget"

# used by sysvinit_2
SERIAL_CONSOLE = "115200 ttyS0"
IMAGE_FSTYPES ?= "jffs2"
EXTRA_IMAGECMD_jffs2 = "--pad --little-endian --eraseblock=0x20000 -n"

require conf/machine/include/tune-arm926ejs.inc
```

## open_embedded_stable_ati/oe_at91sam/conf/machine/at91sam9m10ekes.conf
```bitbake
#@TYPE: Machine
#@Name: Atmel AT91SAM9G45EKES Development Platform
#@DESCRIPTION: Machine configuration for the at91sam9m10ekes development board with a at91sam9m10-es processor

TARGET_ARCH = "arm"

PREFERRED_PROVIDER_virtual/kernel = "linux"
PREFERRED_PROVIDER_xserver = "xserver-kdrive"

KERNEL_IMAGETYPE = "uImage"
UBOOT_ENTRYPOINT = "0x70008000"
UBOOT_LOADADDRESS = "0x70008000"

#don't try to access tty1
USE_VT = "0"

MACHINE_FEATURES = "kernel26 alsa ext2 usbhost usbgadget screen touchscreen"

# used by sysvinit_2
SERIAL_CONSOLE = "115200 ttyS0"
IMAGE_FSTYPES ?= "jffs2"
EXTRA_IMAGECMD_jffs2 = "--pad --little-endian --eraseblock=0x20000 -n"

require conf/machine/include/tune-arm926ejs.inc
```

## open_embedded_stable_ati/oe_at91sam/conf/machine/at91sam9xeek.conf
```bitbake
#@TYPE: Machine
#@Name: Atmel AT91SAM9XEEK Development Platform
#@DESCRIPTION: Machine.inciguration for the at91sam9xeek development board with a at91sam9xe processor

TARGET_ARCH = "arm"

PREFERRED_PROVIDER_virtual/kernel = "linux"

KERNEL_IMAGETYPE = "uImage"

#don't try to access tty1
USE_VT = "0"

MACHINE_FEATURES = "kernel26 alsa ext2 usbhost usbgadget"

# used by sysvinit_2
SERIAL_CONSOLE = "115200 ttyS0"
IMAGE_FSTYPES ?= "jffs2"
EXTRA_IMAGECMD_jffs2 = "--pad --little-endian --eraseblock=0x20000 -n"

require conf/machine/include/tune-arm926ejs.inc
```
